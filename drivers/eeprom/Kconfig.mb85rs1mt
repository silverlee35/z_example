## drivers/eeprom/Kconfig.mb85rs1mt
```kconfig
# Copyright (c) 2024 Antmicro <www.antmicro.com>
# SPDX-License-Identifier: Apache-2.0

config EEPROM_MB85RS1MT
	bool "FUJITSU MB85RS1MT SPI FRAM"
	default y
	depends on DT_HAS_FUJITSU_MB85RS1MT_ENABLED
	select SPI
	help
	  Enable FUJITSU mb85rs1mt SPI FRAM
```

## drivers/sensor/wsen/wsen_itds/Kconfig
```kconfig
# SPDX-License-Identifier: Apache-2.0
#
# Copyright (c) 2020 Linumiz

config ITDS
	bool "WSEN-ITDS 3-axis accel sensor"
	default y
	depends on DT_HAS_WE_WSEN_ITDS_ENABLED
	select I2C
	help
	  Enable Wurth Elektronik WSEN-ITDS 3-axis acceleration sensor
	  provides acceleration and die temperature measurement.

if ITDS

config ITDS_TRIGGER
	bool "Trigger mode"
	depends on GPIO
	depends on $(dt_compat_any_has_prop,$(DT_COMPAT_WE_WSEN_ITDS),int-gpios)
	help
	  Set to enable trigger mode using gpio interrupt, interrupts are
	  configured to line INT0.

endif # ITDS
```

## dts/bindings/mtd/fujitsu,mb85rs1mt.yaml
```yaml
# Copyright (c) 2024 Antmicro <www.antmicro.com>
# SPDX-License-Identifier: Apache-2.0

description: Fujitsu MB85RS1MT SPI FRAM

compatible: "fujitsu,mb85rs1mt"

include: ["eeprom-base.yaml", spi-device.yaml]

properties:
  size:
    required: true
    description: Total FRAM size in bytes.
```

## dts/bindings/sensor/st,ilps22qs-spi.yaml
```yaml
# Copyright (c) 2023 STMicroelectronics
# SPDX-License-Identifier: Apache-2.0

description: |
    STMicroelectronics LPS22DF pressure and temperature sensor connected to I2C
    bus

compatible: "st,ilps22qs"

include: ["spi-device.yaml", "st,ilps22qs-common.yaml"]
```

## samples/drivers/crypto/Kconfig
```kconfig
# Copyright 2024 NXP
# SPDX-License-Identifier: Apache-2.0

if CRYPTO_NXP_S32_HSE

config CRYPTO_NXP_S32_HSE_FORMAT_KEY_CATALOG
	bool "NXP S32 HSE crypto driver supports formatting all key catalogs during initialization."
	help
	  Enable supports formatting all key catalogs during initialization.
	  This feature is primarily used for testing purposes.

endif #CRYPTO_NXP_S32_HSE

source "Kconfig.zephyr"
```

## subsys/bluetooth/crypto/Kconfig
```kconfig
# Copyright (c) 2022 Nordic Semiconductor ASA
# SPDX-License-Identifier: Apache-2.0

config BT_CRYPTO
	bool
	depends on PSA_CRYPTO_CLIENT
	select PSA_WANT_KEY_TYPE_AES
	select PSA_WANT_ALG_CMAC
	help
	  This option enables the Bluetooth Cryptographic Toolbox.
```
